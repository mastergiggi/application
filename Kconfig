## Kconfig
```kconfig
# Copyright (c) 2024 Stefan Giggenbach (https://github.com/mastergiggi)
# SPDX-License-Identifier: Apache-2.0
#
# Kconfig entry point defined in zephyr/module.yml
#
# Modify options using
#   west build -t menuconfig app
# from repository root directory.
#
# To use (external) modules (e.g. LittleFS, mbedtls, etc.) add them
# to west.yml --> manifest --> projects --> import --> name-allowlist

rsource "lib/Kconfig"
```

## lib/Kconfig
```kconfig
# Copyright (c) 2024 Stefan Giggenbach (https://github.com/mastergiggi)
# SPDX-License-Identifier: Apache-2.0

menu "Libraries"

rsource "osal/Kconfig"

endmenu
```

## lib/osal/Kconfig
```kconfig
# Copyright (c) 2024 Stefan Giggenbach (https://github.com/mastergiggi)
# SPDX-License-Identifier: Apache-2.0

config LIB_OSAL
	bool "Operating System Abstraction Layer (OSAL) support"
	help
	  This option enables the OSAL library (C++17 required)
```

## west.yml
```yaml
# Copyright (c) 2024 Stefan Giggenbach (https://github.com/mastergiggi)
# SPDX-License-Identifier: Apache-2.0
#
# Manifest file, which defines the additional module repositories
# of the workspace managed by west. Use west update to clone the
# project/module repositories.


manifest:
  remotes:
    - name: zephyrproject-rtos
      url-base: https://github.com/zephyrproject-rtos

  projects:
    - name: zephyr
      remote: zephyrproject-rtos
      revision: main
      import:
        # By using name-allowlist we can clone only the modules that are
        # strictly needed by the application.
        name-allowlist:
          - cmsis      # required by the ARM port
          - hal_stm32  # required by the nucleo_f302r8 board (STM32 based)
```

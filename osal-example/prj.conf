## prj.conf
```kconfig
# Copyright (c) 2024 Stefan Giggenbach (https://github.com/mastergiggi)
# SPDX-License-Identifier: Apache-2.0
#
# Enable configuration required to build

# Enable C++17 support
CONFIG_CPP=y
CONFIG_REQUIRES_FULL_LIBCPP=y
CONFIG_STD_CPP17=y

# Configure heap size
CONFIG_HEAP_MEM_POOL_SIZE=1024

# Enable dynamic allocation of thread stack on heap
CONFIG_THREAD_STACK_INFO=y
CONFIG_DYNAMIC_THREAD=y
CONFIG_DYNAMIC_THREAD_ALLOC=y
CONFIG_DYNAMIC_THREAD_PREFER_ALLOC=y

# Enable OSAL C++ Lib
CONFIG_LIB_OSAL=y
```

## src/main.cpp
```c
/*
 * Copyright (c) 2024 Stefan Giggenbach (https://github.com/mastergiggi)
 * SPDX-License-Identifier: Apache-2.0
 */

#include <cstdlib>
#include <cstdio>

#include <app_version.h>
#include <zephyr/sys/printk.h>
#include <osal/os-thread.hpp>

static void myThreadFunction()
{
	while (true) {
		printf("%s: Hello World!\n", __FUNCTION__);
		OS::Thread::msleep(500);
	}
}

int main()
{
	printf("Zephyr OSAL C++ Example Application %s\n", APP_VERSION_STRING);
	
	static OS::Thread::Config myThreadConfig =
	{
		.name = "Test-Thread",
		.stackSize = 512,
		.prio = 1
	};

	OS::Thread myThread(myThreadFunction, myThreadConfig);

	int count = 0;
	while (count < 5) {
		printf("%s: Hello World!\n", __FUNCTION__);
		++count;
		OS::Thread::sleep(1);
	}

	myThread.abort();
	myThread.join();

	return EXIT_SUCCESS;
}
```
